/*
 * Copyright 2014 Raphaël Poggi
 * Copyright 2012 Freescale Semiconductor, Inc.
 * Copyright 2011 Linaro Ltd.
 *
 * The code contained herein is licensed under the GNU General Public
 * License. You may obtain a copy of the GNU General Public License
 * Version 2 or later at the following locations:
 *
 * http://www.opensource.org/licenses/gpl-license.html
 * http://www.gnu.org/copyleft/gpl.html
 */

/dts-v1/;

#include "imx6dl.dtsi"
#include "imx6qdl-udoo.dtsi"

/ {
       model = "Udoo i.MX6 Dual Board";
       compatible = "fsl,imx6dl-udoo", "fsl,imx6dl";
};
